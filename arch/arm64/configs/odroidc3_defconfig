## arch/arm64/configs/odroidc3_defconfig
```kconfig
CONFIG_ARCH_MESON64_ODROIDC3=y
CONFIG_RTC_DRV_PCF8563=y
CONFIG_GPIO_RESET_CONTROLLER=y
```

## arch/arm64/configs/odroidn2_defconfig
```kconfig
CONFIG_ARCH_MESON64_ODROIDN2=y
CONFIG_RT2X00=m
CONFIG_RT2800USB=m
# CONFIG_RT2800USB_RT33XX is not set
# CONFIG_RT2800USB_RT35XX is not set
CONFIG_RT2800USB_RT53XX=y
CONFIG_RT2800USB_RT55XX=y
CONFIG_INPUT_TOUCHSCREEN=y
CONFIG_TOUCHSCREEN_DWAV_USB_MT=y
CONFIG_TOUCHSCREEN_SX8650=m
CONFIG_AMLOGIC_GPIOMEM=y
CONFIG_HID_BETOP_FF=y
CONFIG_HID_MULTITOUCH=y
CONFIG_FB_TFT=m
CONFIG_FB_TFT_AGM1264K_FL=m
CONFIG_FB_TFT_BD663474=m
CONFIG_FB_TFT_HX8340BN=m
CONFIG_FB_TFT_HX8347D=m
CONFIG_FB_TFT_HX8353D=m
CONFIG_FB_TFT_HX8357D=m
CONFIG_FB_TFT_ILI9163=m
CONFIG_FB_TFT_ILI9320=m
CONFIG_FB_TFT_ILI9325=m
CONFIG_FB_TFT_ILI9340=m
CONFIG_FB_TFT_ILI9341=m
CONFIG_FB_TFT_ILI9481=m
CONFIG_FB_TFT_ILI9486=m
CONFIG_FB_TFT_PCD8544=m
CONFIG_FB_TFT_RA8875=m
CONFIG_FB_TFT_S6D02A1=m
CONFIG_FB_TFT_S6D1121=m
CONFIG_FB_TFT_SSD1289=m
CONFIG_FB_TFT_SSD1305=m
CONFIG_FB_TFT_SSD1306=m
CONFIG_FB_TFT_SSD1325=m
CONFIG_FB_TFT_SSD1331=m
CONFIG_FB_TFT_SSD1351=m
CONFIG_FB_TFT_ST7735R=m
CONFIG_FB_TFT_ST7789V=m
CONFIG_FB_TFT_TINYLCD=m
CONFIG_FB_TFT_TLS8204=m
CONFIG_FB_TFT_UC1611=m
CONFIG_FB_TFT_UC1701=m
CONFIG_FB_TFT_UPD161704=m
CONFIG_FB_TFT_WATTEROTT=m
CONFIG_FB_FLEX=m
CONFIG_FB_TFT_FBTFT_DEVICE=m
CONFIG_PWM_GPIO=y
CONFIG_GPIO_RESET_CONTROLLER=y
```

## drivers/hardkernel/Kconfig
```kconfig
menu "ODROID Specific Hardware"

config ODROIDN2_SYSFS
	bool "Hardkernel ODROID-N2 sysfs Support"
	default n
	help
	   Hardkernel sysfs
endmenu
```
